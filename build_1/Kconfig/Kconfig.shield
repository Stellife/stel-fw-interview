## build_1/Kconfig/Kconfig.shield
```kconfig
osource "/Users/jacobjunk/dev/zephyr/central/stel-fw-interview/boards/shields/*/Kconfig.shield"
osource "/opt/nordic/ncs/v2.7.0/nrf/boards/shields/*/Kconfig.shield"
```

## build_1/Kconfig/Kconfig.shield.defconfig
```kconfig
osource "/Users/jacobjunk/dev/zephyr/central/stel-fw-interview/boards/shields/*/Kconfig.defconfig"
osource "/opt/nordic/ncs/v2.7.0/nrf/boards/shields/*/Kconfig.defconfig"
```
